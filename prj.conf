## CMakeLists.txt
```
# SPDX-License-Identifier: Apache-2.0

cmake_minimum_required(VERSION 3.28.0)
# Board 定义在 ${BOARD_ROOT}/boards/arm/stm32f407_balance_car,
# 因此 BOARD_ROOT 要指向包含 'boards' 子目录的目录 (即本工程的上一级).
get_filename_component(BOARD_ROOT "${CMAKE_CURRENT_SOURCE_DIR}/.." ABSOLUTE)

# 直接 cmake 构建 (不走 west) 时模块系统不会自动加载 hal_stm32,
# 导致 board dts 里的 #include <st/f4/stm32f407z(e-g)tx-pinctrl.dtsi> 解析不到.
# 这里手动把 hal_stm32 模块的 dts 根注册进 DTS_ROOT, 让 pinctrl 定义可见.
list(APPEND DTS_ROOT "$ENV{ZEPHYR_BASE}/../modules/hal/stm32")

# 显式指定应用级 DTS overlay (添加 USART2 DMA 配置)
set(EXTRA_DTC_OVERLAY_FILE ${CMAKE_CURRENT_SOURCE_DIR}/boards/stm32f407_balance_car.overlay)

find_package(Zephyr REQUIRED HINTS $ENV{ZEPHYR_BASE})
project(car_2026)

target_sources(app PRIVATE
    src/main.c
    src/menu/menu_input.c
    src/menu/menu.c
    src/menu/OLED_Menu.c
    src/menu/font.c
    src/ano/ano_true.c
    src/ano/ano_base.c
    src/ano/ano_board_init.c
    src/ano/ano_device/ano_device_com.c
    src/ano/ano_device/ano_device_k230.c
    src/uart/uart_base.c
    src/uart/uart_true.c
    src/uart/uart_board_init.c
    src/mpu6050/mpu6050.c
    src/mpu6050/euler.c
    src/mess/value_to_str.c
    src/encode/encode.c
    src/motor/tb6612.c
    src/key/key.c
    src/debug/debug.c
    src/simulink/ARMCortex-M/car_2026/car_2026.c
    src/simulink/ARMCortex-M/car_2026/rt_nonfinite.c
    src/event/event.c
    src/tim/tim.c
    src/tim/soft_timer.c
    src/double_tree/double_tree.c
    # src/simulink/ARMCortex-M/car_2026/blinky_data.c
    
)

target_include_directories(app PRIVATE
    src
    src/menu
    src/ano
    src/ano/ano_device
    src/uart
    src/mpu6050
    src/mess
    src/encode
    src/motor
    src/key
    src/simulink/ARMCortex-M/car_2026
    src/debug
    src/event
    src/tim
    src/double_tree
)
```

## prj.conf
```kconfig
CONFIG_SYS_CLOCK_EXISTS=y
CONFIG_DEBUG=y
CONFIG_SYS_CLOCK_TICKS_PER_SEC=1000

######  OLED #####
#SSD1306

#enable I2c
CONFIG_I2C=y

#enable SSD1306 display
CONFIG_SSD1306=y

#enable display subsystem
CONFIG_DISPLAY=y

#cfb 字符帧缓冲(提供 cfb_* API)
CONFIG_CHARACTER_FRAMEBUFFER=y

# 禁用内置默认字体，只用自己的
CONFIG_CHARACTER_FRAMEBUFFER_USE_DEFAULT_FONTS=n

#cfb 内部用 k_malloc 分配帧缓冲，需要内核堆
CONFIG_HEAP_MEM_POOL_SIZE=2048

# 系统工作队列栈 —— 软定时器回调在此执行，需要足够空间
# 回调链: work_handler → tree_queue_push → k_mutex_lock → k_sem_give (调度器操作)
CONFIG_SYSTEM_WORKQUEUE_STACK_SIZE=4096


#MPU6050
CONFIG_SENSOR=y
CONFIG_MPU6050=y

#如果使用lvgl
#CONFIG_LVGL=y

#按键 Input Subsystem(可选)

CONFIG_INPUT=y
CONFIG_INPUT_GPIO_KEYS=y

#shell(i2c scan调试)
# CONFIG_SHELL=y
# CONFIG_I2C_SHELL=y


#串口
CONFIG_SERIAL=y
CONFIG_UART_INTERRUPT_DRIVEN=y      #中断驱动
CONFIG_DMA=y                        #开启DMA
CONFIG_DMA_STM32=y
CONFIG_RING_BUFFER=y                #环形缓冲区 (IT 模式 TX)
CONFIG_UART_INTERRUPT_DRIVEN=y      #uart_it 开启
CONFIG_UART_ASYNC_API=y             #异步开启

#断言支持 调试状态下使用 控制台调试
CONFIG_ASSERT=y
# INF 级别
CONFIG_LOG_DEFAULT_LEVEL=3          
CONFIG_LOG=y
CONFIG_LOG_BACKEND_UART=y
CONFIG_CONSOLE=y

#开启编码器
CONFIG_QDEC_STM32=y

#定时器
CONFIG_COUNTER=y
CONFIG_COUNTER_TIMER_STM32=y

# PWM 开启motor
CONFIG_PWM=y
CONFIG_GPIO=y
```

## stm32f407_balance_car.overlay
```dts
#include <arm/armv7-m.dtsi>
#include <st/f4/stm32f407Xe.dtsi>
#include <st/f4/stm32f407z(e-g)tx-pinctrl.dtsi>

#include <zephyr/dt-bindings/dma/stm32_dma.h>

&usart2 {
	pinctrl-0 = <&usart2_tx_pa2 &usart2_rx_pa3>;
	pinctrl-names = "default";
	current-speed = <460800>;
	dmas = <&dma1 6 4 STM32_DMA_PERIPH_TX STM32_DMA_FIFO_FULL>,
	       <&dma1 5 4 STM32_DMA_PERIPH_RX STM32_DMA_FIFO_FULL>;
	dma-names = "tx", "rx";
	status = "okay";
};
```

## boards/stm32f407_balance_car.overlay
```dts
#include <zephyr/dt-bindings/dma/stm32_dma.h>

&usart2 {
	/* STM32F407 DMA 映射 (参考 RM0090 Table 27):
	 * USART2_TX -> DMA1 Stream 4 (ch4) 或 Stream 7 (ch4)
	 * USART2_RX -> DMA1 Stream 5 (ch4)
	 */
	/* current-speed = <115200>; */
	dmas = <&dma1 6 4 STM32_DMA_PERIPH_TX STM32_DMA_FIFO_FULL>,
	       <&dma1 5 4 STM32_DMA_PERIPH_RX STM32_DMA_FIFO_FULL>;
	dma-names = "tx", "rx";
};

&usart3 {
	/* STM32F407 DMA 映射 (参考 RM0090 Table 27):
	 * USART2_TX -> DMA1 Stream 4 (ch4) 或 Stream 7 (ch4)
	 * USART2_RX -> DMA1 Stream 5 (ch4)
	 */
	/* current-speed = <115200>; */
	dmas = <&dma1 3 3 STM32_DMA_PERIPH_TX STM32_DMA_FIFO_FULL>,
	       <&dma1 1 3 STM32_DMA_PERIPH_RX STM32_DMA_FIFO_FULL>;
	dma-names = "tx", "rx";
};
```

## src/main.c
```c
#include "ano/ano_base.h"
#include "double_tree/double_tree.h"
#include "encode.h"
#include "euler.h"
#include "menu/OLED_Menu.h"
#include "menu/menu.h"
#include "motor/tb6612.h"
#include "simulink/ARMCortex-M/car_2026/car_2026.h"
#include "uarts.h"
#include "value_to_str.h"
#include "zephyr/kernel.h"
#include <stddef.h>
#include <stdint.h>
#include <stdio.h>
#include <string.h>
#include <sys/_intsup.h>
#include "event.h"  
#include "zephyr/kernel/thread.h"
#include "zephyr/kernel/thread_stack.h"
#include "zephyr/syscalls/kernel.h"

K_MSGQ_DEFINE(uart_rx_queue, sizeof(struct uart_event_t), 30,4);

static K_THREAD_STACK_DEFINE(s_statck_ano, 4096);      
static K_THREAD_STACK_DEFINE(s_stack_rx,2048);
static K_THREAD_STACK_DEFINE(s_statck_dispatch, 4096); 
static K_THREAD_STACK_DEFINE(s_stack_1ms_high, 4096); 
static K_THREAD_STACK_DEFINE(s_stack_5ms_high, 4096); 
static K_THREAD_STACK_DEFINE(s_stack_10ms, 4096); 
static K_THREAD_STACK_DEFINE(s_stack_5ms_low,4096);


static struct k_thread s_thread_ano;
static struct k_thread s_thread_rx;
static struct k_thread s_thread_5ms_high;
static struct k_thread s_thread_5ms_low;
static struct k_thread s_thread_dispatch;
static struct k_thread s_thread_10ms;
static struct k_thread s_thread_1ms_high;


extern struct k_sem tim5_sem;
extern struct k_msgq ano_tx_queue;
static K_SEM_DEFINE(uart_print_sem, 0, 1); // 初始计数值为0，最大值为1，用作二进制信号量

tree_queue_t *tree;

static void s_task_1ms_high(void *p1,void *p2,void *p3)
{
	while (1) {
        k_sem_take(&tim5_sem, K_FOREVER);
        car_2026_step0();
        motor_set(g_motor_a_pst, car_2026_Y.pwm_a);
        motor_set(g_motor_b_pst, car_2026_Y.pwm_b);

	}
}

void s_task_5ms_high(void *p1,void *p2,void *p3 )
{
    while (1) {
        euler_update();
        encoder_update_all();
        struct encoder_data_t motor_a;
        struct encoder_data_t motor_b;
        encoder_get_data(g_encoder_a_pst, &motor_a);
        encoder_get_data(g_encoder_b_pst, &motor_b);
        car_2026_U.spd_a = motor_a.rpm_f;
        car_2026_U.spd_b = motor_b.rpm_f;

        car_2026_step1();
        k_sem_give(&uart_print_sem);
        k_sleep(K_MSEC(4));
    }
}



#define TELEMETRY_BUF_SIZE (150U)
#define TELEMETRY_FIELD_SIZE    (10U)

static void format_telemetry(char *buf, size_t buf_size) {
  char tar_spd_a[TELEMETRY_FIELD_SIZE];
  char tar_spd_b[TELEMETRY_FIELD_SIZE];
  char motor_a_fliter[TELEMETRY_FIELD_SIZE];
  char motor_b_fliter[TELEMETRY_FIELD_SIZE];
  char pwm_b[TELEMETRY_FIELD_SIZE];
  char yaw[TELEMETRY_FIELD_SIZE];
  char turn_spd[TELEMETRY_FIELD_SIZE];

  float_to_str(tar_spd_a, sizeof(tar_spd_a), car_2026_Y.tar_spd_a_2, 2);
  float_to_str(tar_spd_b, sizeof(tar_spd_b), car_2026_Y.tar_spd_b_2, 2);
  float_to_str(motor_a_fliter, sizeof(motor_a_fliter), car_2026_Y.spd_fliter_a, 2);
  float_to_str(motor_b_fliter, sizeof(motor_b_fliter), car_2026_Y.spd_fliter_b, 2);
  float_to_str(pwm_b, sizeof(pwm_b), car_2026_Y.pwm_b, 2);
  float_to_str(yaw, sizeof(yaw), car_2026_Y.yaw_out, 2);
  float_to_str(turn_spd, sizeof(turn_spd), car_2026_Y.turn_spd, 2);

  snprintf(buf, buf_size, "%s,%s,%s,%s,%s,%s,%s\r\n",tar_spd_a,
           tar_spd_b,motor_a_fliter,motor_b_fliter,pwm_b,yaw,
        turn_spd);
}

static void menu_refresh(void)
{
    menu_request_refresh(g_mpu6050_euler_oled_pst);
    menu_request_refresh(g_mpu6050_raw_oled_pst);
}

//要加入循环才行
void s_task_5ms_low(void* p1,void* p2,void *p3)
{
    static char s_telemetry_buf[TELEMETRY_BUF_SIZE];
    while (1) {
        k_sem_take(&uart_print_sem, K_FOREVER);
        menu_refresh();
        format_telemetry(s_telemetry_buf, sizeof(s_telemetry_buf));
        uart_transmit(g_uart_computer, s_telemetry_buf, strlen(s_telemetry_buf));
        menu_task_v();
    }
}


void s_task_10ms(void* p1,void* p2,void *p3)
{

    for (;;) {
        car_2026_step2();
        k_sleep(K_MSEC(9));
    }
}

void s_task_dispatch(void* p1,void* p2,void *p3)
{
    struct event_t evt;
    tree = tree_queue_create();
    for (;;)
    {
        tree_err_t ret = tree_queue_pop(tree,&evt, K_FOREVER);    
        if (ret == TREE_OK) {
            dispatch_event(&evt);
        }
    }
}


void s_task_rx(void* p1,void* p2, void* p3)
{
    struct uart_event_t uart_event;
    for (; ; ) {
        k_msgq_get(&uart_rx_queue, &uart_event, K_FOREVER);
        if (uart_event.type_e == UART_EVENT_RX_DATA) {
            uart_rx_analyze(uart_event.base);
        }
    }
}

void s_task_ano(void* p1,void* p2,void* p3)
{
    struct ano_event_t event;
    for (; ; ) {
        k_msgq_get(&ano_tx_queue, &event, K_FOREVER);
        ano_send_data(event.me, event.frame);
    }
}

int main(void)
{

    k_thread_create(&s_thread_1ms_high, s_stack_1ms_high, sizeof(s_stack_1ms_high), s_task_1ms_high, NULL, NULL, NULL, K_PRIO_PREEMPT(3), 0, K_NO_WAIT);
    k_thread_create(&s_thread_5ms_high, s_stack_5ms_high, sizeof(s_stack_5ms_high), s_task_5ms_high, NULL, NULL, NULL, K_PRIO_PREEMPT(4), 0, K_NO_WAIT);
    k_thread_create(&s_thread_5ms_low, s_stack_5ms_low, sizeof(s_stack_5ms_low), s_task_5ms_low, NULL, NULL, NULL, K_PRIO_PREEMPT(10), 0, K_NO_WAIT);
    k_thread_create(&s_thread_10ms, s_stack_10ms, sizeof(s_stack_10ms),s_task_10ms, NULL,NULL, NULL, K_PRIO_PREEMPT(5), 0,K_NO_WAIT);
    k_thread_create(&s_thread_dispatch, s_statck_dispatch, sizeof(s_statck_dispatch),s_task_dispatch, NULL,NULL, NULL, K_PRIO_PREEMPT(7), 0,K_NO_WAIT);
    k_thread_create(&s_thread_ano, s_statck_ano, sizeof(s_statck_ano),s_task_ano, NULL,NULL, NULL, K_PRIO_PREEMPT(6), 0,K_NO_WAIT);
    k_thread_create(&s_thread_rx, s_stack_rx, sizeof(s_stack_rx),s_task_rx, NULL,NULL, NULL, K_PRIO_PREEMPT(7), 0,K_NO_WAIT);


    while (1) {
        k_sleep(K_MSEC(1000));
	}
	return 0;
}
```
